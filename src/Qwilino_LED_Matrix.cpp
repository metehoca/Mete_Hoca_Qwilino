#include "Qwilino_LED_Matrix.h"

const uint32_t Qwilino_Gallery_Heart[3]     = {0x3184a444, 0x42081100, 0xa0040000};
const uint32_t Qwilino_Gallery_Smile[3]     = {0x3184a444, 0x42081100, 0x00000000}; 
const uint32_t Qwilino_Gallery_Sad[3]       = {0x00000000, 0x42081100, 0x3184a444}; 
const uint32_t Qwilino_Gallery_Check[3]     = {0x00000000, 0x00000408, 0x12240000};
const uint32_t Qwilino_Gallery_Cross[3]     = {0x40080000, 0x02100804, 0x00001002};
const uint32_t Qwilino_Gallery_ArrowUp[3]   = {0x00000000, 0x00000000, 0x00000000}; 
const uint32_t Qwilino_Gallery_ArrowDown[3] = {0x00000000, 0x00000000, 0x00000000}; 

static const uint8_t font5x7[][5] = {
  {0x00,0x00,0x00,0x00,0x00}, {0x00,0x00,0x5F,0x00,0x00}, {0x00,0x07,0x00,0x07,0x00}, 
  {0x14,0x7F,0x14,0x7F,0x14}, {0x24,0x2A,0x7F,0x2A,0x12}, {0x23,0x13,0x08,0x64,0x62}, 
  {0x36,0x49,0x55,0x22,0x50}, {0x00,0x05,0x03,0x00,0x00}, {0x00,0x1C,0x22,0x41,0x00}, 
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  {0x44,0x64,0x54,0x4C,0x44}
};

Qwilino_LED_Matrix::Qwilino_LED_Matrix(uint8_t i2c_addr) {
  _i2c_addr = i2c_addr;
  clear();
}

bool Qwilino_LED_Matrix::begin(TwoWire &wirePort) {
  _i2c = &wirePort;
  _i2c->begin();
  _i2c->beginTransmission(_i2c_addr);
  if (_i2c->endTransmission() != 0) return false;
  return true;
}

void Qwilino_LED_Matrix::clear() {
  for (int i = 0; i < 12; i++) _buffer[i] = 0x00;
}

void Qwilino_LED_Matrix::setPixel(int8_t x, int8_t y, bool state) {
  if (x < 0 || x >= 12 || y < 0 || y >= 8) return;
  if (state) _buffer[x] |= (1 << y);
  else _buffer[x] &= ~(1 << y);
}

void Qwilino_LED_Matrix::loadFrame(const uint32_t frame[3]) {
  for (int i = 0; i < 3; i++) {
    _buffer[(i * 4) + 0] = (frame[i] >> 24) & 0xFF;
    _buffer[(i * 4) + 1] = (frame[i] >> 16) & 0xFF;
    _buffer[(i * 4) + 2] = (frame[i] >> 8) & 0xFF;
    _buffer[(i * 4) + 3] = frame[i] & 0xFF;
  }
}

void Qwilino_LED_Matrix::drawChar(int8_t x, int8_t y, char c) {
  if (c < 32 || c > 126) return;
  c -= 32;
  for (int8_t i = 0; i < 5; i++) {
    uint8_t line = font5x7[(uint8_t)c][i];
    for (int8_t j = 0; j < 8; j++) {
      if (line & (1 << j)) setPixel(x + i, y + j, true);
    }
  }
}

void Qwilino_LED_Matrix::printText(const char* text, int8_t x, int8_t y) {
  int8_t cursor_x = x;
  while (*text) {
    drawChar(cursor_x, y, *text++);
    cursor_x += 6; 
  }
}

void Qwilino_LED_Matrix::scrollText(const char* text, uint16_t speed_ms) {
  int textLength = 0;
  const char* temp = text;
  while (*temp++) textLength++;
  
  int totalWidth = textLength * 6;
  
  for (int offset = 12; offset > -totalWidth; offset--) {
    clear();
    printText(text, offset, 1);
    show();
    delay(speed_ms);
  }
}

void Qwilino_LED_Matrix::show() {
  _i2c->beginTransmission(_i2c_addr);
  _i2c->write(REG_FRAME_DATA);
  for (int i = 0; i < 12; i++) _i2c->write(_buffer[i]);
  _i2c->endTransmission();
}